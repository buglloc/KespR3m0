## components/appsman/Kconfig
```kconfig
menu "KespR3m0 Apps"

  config KESPR_APPS_DISPATCH_WORKERS
    int "Dispatch workers"
    default 1

  config KESPR_APPS_TASK_PRIORITY
    int "Task priority"
    default 5

  config KESPR_APPS_TASK_STACK_SIZE
    int "Task stack size"
    default 4096

  config KESPR_APPS_DISPATCH_QUEUE
    int "Dispatch queue"
    default 6

  config KESPR_APPS_DISPATCH_TIMEOUT_MS
    int "Dispatch timeout (ms)"
    default 500

endmenu
```

## components/board/Kconfig
```kconfig
menu "KespR3m0 Network"

  config KESPR_HOSTNAME
    string "Hostname"
    default "KespR3m0"

  config KESPR_NET_CONNECT_RETRIES
    int "Connect retries"
    default 4

  menu "WiFi STA"

    config KESPR_NET_STA_SSID
      string "SSID"
      default "BuggIOT"

    config KESPR_NET_STA_PASSWORD
      string "Password"

    config KESPR_NET_STA_USE_STATIC_IP
      bool "Use static IP"
      default n

    config KESPR_NET_STA_IP
      string "IP"
      default "10.0.97.97"
      depends on KESPR_NET_STA_USE_STATIC_IP

    config KESPR_NET_STA_SUBNET
      string "Subnet"
      default "255.255.0.0"
      depends on KESPR_NET_STA_USE_STATIC_IP

    config KESPR_NET_STA_GW
      string "Gateway"
      default "10.0.0.1"
      depends on KESPR_NET_STA_USE_STATIC_IP

    config KESPR_NET_STA_DNS
      string "DNS"
      default "10.0.0.2"
      depends on KESPR_NET_STA_USE_STATIC_IP

  endmenu

  menu "WiFi AP"

    config KESPR_NET_AP_SSID
      string "SSID"
      default "KespR3m0"

    config KESPR_NET_AP_PASSWORD
      string "Password"

    config KESPR_NET_AP_IP
      string "IP"
      default "192.168.8.1"

    config KESPR_NET_AP_SUBNET
      string "Subnet"
      default "255.255.0.0"

    config KESPR_NET_AP_GW
      string "Gateway"
      default "10.0.0.1"

    config KESPR_NET_AP_DNS
      string "DNS"
      default "10.0.0.1"

    config KESPR_NET_AP_CHANNEL
      int "WiFi Channel"
      range 1 13
      default 1

    config KESPR_NET_AP_CONN
      int "Maximal STA connections"
      default 4

  endmenu

endmenu
```

## components/gui/Kconfig
```kconfig
menu "KespR3m0 GUI"

  config KESPR_DEFAULT_BRIGHTNESS
    int "Display brightness"
    default 40

  config KESPR_GUI_LVGL_TICK_MS
    int "LVGL tick period (ms)"
    default 5

  config KESPR_GUI_LVGL_TASK_STACK
    int "LVGL task stack size"
    default 8192

  config KESPR_GUI_LVGL_TASK_PRIO
    int "LVGL task prio"
    default 5

  config KESPR_GUI_LVGL_TASK_AFFINITY
    int "LVGL task core affinity"
    default -1

  config KESPR_GUI_PERIOD_TIME_MS
    int "GUI update period time (ms)"
    range 5 500
    default 120

endmenu
```

## components/httpd/Kconfig
```kconfig
menu "KespR3m0 HTTPD"

  config KESPR_HTTP_DEVMODE
    bool "Dev Mode"
    default n

  config KESPR_HTTP_PORT
    int "Listen port"
    default 80

  config KESPR_HTTP_BUF_SIZE
    int "HTTP buf size"
    default 4096

  config KESPR_WS_BUF_SIZE
    int "WS buf size"
    default 4096

  config KESPR_HTTP_FORCE_GZIP
    bool "Force gzip encoding"
    default y

  config KESPR_HTTP_MAX_CLIENTS
    int "Maximum clients"
    default 12

endmenu
```

## main/Kconfig
```kconfig
menu "KespR3m0 Runtime"

  config KESPR_DEVMODE
    bool "Dev Mode"
    default n

endmenu
```

## main/Kconfig.projbuild
```kconfig
menu "KespR3m0"

  menu "USB Keyboard Service"

    config KESPR_USBKBD_ENABLED
      bool "Enabled"
      default y

  endmenu

  menu "UART Service"

    config KESPR_UARTD_ENABLED
      bool "Enabled"
      default y

    config KESPR_UARTD_RX_PIN
      int "RX PIN"
      default 15
      depends on KESPR_UARTD_ENABLED

    config KESPR_UARTD_TX_PIN
      int "TX PIN"
      default 16
      depends on KESPR_UARTD_ENABLED

    config KESPR_UARTD_DEFAULT_BRAUD
      int "Default braud"
      default 115200
      depends on KESPR_UARTD_ENABLED

    config KESPR_UARTD_BUF_SIZE
      int "Buff size"
      default 1024
      depends on KESPR_UARTD_ENABLED

    config KESPR_UARTD_READ_PERIOD
      int "Read period (ms)"
      default 500
      depends on KESPR_UARTD_ENABLED

    config KESPR_UARTD_RX_STACK_SIZE
      int "Buff size"
      default 4096
      depends on KESPR_UARTD_ENABLED

  endmenu

endmenu
```

## sdkconfig.defaults
```kconfig
CONFIG_ESPTOOLPY_FLASHFREQ_80M=y
CONFIG_ESPTOOLPY_FLASHFREQ_80M_DEFAULT=y
CONFIG_ESPTOOLPY_FLASHFREQ="80m"
CONFIG_ESPTOOLPY_FLASHSIZE_16MB=y
CONFIG_ESPTOOLPY_FLASHSIZE="16MB"
CONFIG_PARTITION_TABLE_CUSTOM=y
CONFIG_PARTITION_TABLE_CUSTOM_FILENAME="partitions.csv"
CONFIG_PARTITION_TABLE_FILENAME="partitions.csv"

CONFIG_SPIFFS_OBJ_NAME_LEN=64
CONFIG_FATFS_LONG_FILENAME=y
CONFIG_FATFS_LFN_HEAP=y

CONFIG_ESP_DEFAULT_CPU_FREQ_MHZ_240=y
CONFIG_ESP_DEFAULT_CPU_FREQ_MHZ=240

CONFIG_SPIRAM=y
CONFIG_SPIRAM_MODE_QUAD=y
CONFIG_SPIRAM_SPEED_80M=y
CONFIG_SPIRAM_SPEED=80
CONFIG_SPIRAM_BOOT_INIT=y
CONFIG_SPIRAM_USE_CAPS_ALLOC=y
CONFIG_SPIRAM_MEMTEST=y
CONFIG_SPIRAM_TRY_ALLOCATE_WIFI_LWIP=y

CONFIG_HTTPD_MAX_REQ_HDR_LEN=1024
CONFIG_HTTPD_WS_SUPPORT=y
CONFIG_LWIP_SO_LINGER=y
CONFIG_LWIP_SO_REUSE=y
CONFIG_LWIP_MAX_SOCKETS=15

#
# LVGL configuration
#
CONFIG_LV_CONF_SKIP=y

CONFIG_LV_COLOR_DEPTH_16=y
CONFIG_LV_COLOR_DEPTH=16

CONFIG_LV_USE_BUILTIN_MALLOC=y
CONFIG_LV_USE_BUILTIN_STRING=y
CONFIG_LV_USE_BUILTIN_SPRINTF=y
CONFIG_LV_MEM_SIZE_KILOBYTES=64
CONFIG_LV_MEM_POOL_EXPAND_SIZE_KILOBYTES=0
CONFIG_LV_MEM_ADR=0x0
CONFIG_LV_DEF_REFR_PERIOD=33
CONFIG_LV_DPI_DEF=130
CONFIG_LV_OS_NONE=y
CONFIG_LV_USE_OS=0
CONFIG_LV_DRAW_BUF_STRIDE_ALIGN=1
CONFIG_LV_DRAW_BUF_ALIGN=4
CONFIG_LV_DRAW_LAYER_SIMPLE_BUF_SIZE=24576
CONFIG_LV_USE_DRAW_SW=y
CONFIG_LV_DRAW_SW_DRAW_UNIT_CNT=1
CONFIG_LV_USE_NATIVE_HELIUM_ASM=y
CONFIG_LV_DRAW_SW_COMPLEX=y
CONFIG_LV_DRAW_SW_SHADOW_CACHE_SIZE=0
CONFIG_LV_DRAW_SW_CIRCLE_CACHE_SIZE=4
CONFIG_LV_DRAW_SW_ASM_NONE=y
CONFIG_LV_USE_DRAW_SW_ASM=0

# CONFIG_LV_USE_LOG is not set

CONFIG_LV_USE_ASSERT_NULL=y
CONFIG_LV_USE_ASSERT_MALLOC=y
CONFIG_LV_ASSERT_HANDLER_INCLUDE="assert.h"


CONFIG_LV_FONT_MONTSERRAT_14=y
CONFIG_LV_FONT_DEFAULT_MONTSERRAT_14=y

#
# Widget Usage
#
CONFIG_LV_WIDGETS_HAS_DEFAULT_VALUE=y
CONFIG_LV_USE_ANIMIMG=y
CONFIG_LV_USE_ARC=y
CONFIG_LV_USE_BAR=y
CONFIG_LV_USE_BUTTON=y
CONFIG_LV_USE_BUTTONMATRIX=y
CONFIG_LV_USE_CALENDAR=n
CONFIG_LV_USE_CANVAS=y
CONFIG_LV_USE_CHART=y
CONFIG_LV_USE_CHECKBOX=n
CONFIG_LV_USE_DROPDOWN=n
CONFIG_LV_USE_IMAGE=y
CONFIG_LV_USE_IMAGEBUTTON=y
CONFIG_LV_USE_KEYBOARD=n
CONFIG_LV_USE_LABEL=y
CONFIG_LV_LABEL_TEXT_SELECTION=y
CONFIG_LV_LABEL_LONG_TXT_HINT=y
CONFIG_LV_LABEL_WAIT_CHAR_COUNT=3
CONFIG_LV_USE_LED=y
CONFIG_LV_USE_LINE=y
CONFIG_LV_USE_LIST=y
CONFIG_LV_USE_MENU=n
CONFIG_LV_USE_MSGBOX=n
CONFIG_LV_USE_OBSERVER=y
CONFIG_LV_USE_ROLLER=y
CONFIG_LV_USE_SCALE=n
CONFIG_LV_USE_SLIDER=n
CONFIG_LV_USE_SPAN=y
CONFIG_LV_SPAN_SNIPPET_STACK_SIZE=64
CONFIG_LV_USE_SPINBOX=
CONFIG_LV_USE_SPINNER=y
CONFIG_LV_USE_SWITCH=y
CONFIG_LV_USE_TEXTAREA=n
CONFIG_LV_USE_TABLE=y
CONFIG_LV_USE_TABVIEW=y
CONFIG_LV_USE_TILEVIEW=y
CONFIG_LV_USE_WIN=y
# end of Widget Usage

#
# Themes
#
CONFIG_LV_USE_THEME_DEFAULT=y
# CONFIG_LV_THEME_DEFAULT_DARK is not set
CONFIG_LV_THEME_DEFAULT_GROW=y
CONFIG_LV_THEME_DEFAULT_TRANSITION_TIME=80
CONFIG_LV_USE_THEME_SIMPLE=y
# CONFIG_LV_USE_THEME_MONO is not set
# end of Themes

CONFIG_LV_USE_QRCODE=y

CONFIG_LV_BUILD_EXAMPLES=n
# end of LVGL configuration
```
